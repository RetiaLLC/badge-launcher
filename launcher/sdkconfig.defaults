## launcher/sdkconfig.defaults
```kconfig
CONFIG_IDF_TARGET="esp32s3"
CONFIG_ESPTOOLPY_FLASHSIZE_8MB=y
CONFIG_ESP_CONSOLE_USB_SERIAL_JTAG=y

CONFIG_PARTITION_TABLE_CUSTOM=y
CONFIG_PARTITION_TABLE_CUSTOM_FILENAME="partitions-shared.csv"
CONFIG_PARTITION_TABLE_OFFSET=0x8000

# Hold UP (GPIO4, active low) ~1s through a reset -> bootloader clears otadata
# and boots the factory partition (this launcher). The erase list MUST stay
# empty: nvs + spiffs hold Meshtastic settings and must survive.
CONFIG_BOOTLOADER_FACTORY_RESET=y
CONFIG_BOOTLOADER_NUM_PIN_FACTORY_RESET=4
CONFIG_BOOTLOADER_FACTORY_RESET_PIN_LOW=y
CONFIG_BOOTLOADER_OTA_DATA_ERASE=y
CONFIG_BOOTLOADER_DATA_FACTORY_RESET=""
CONFIG_BOOTLOADER_HOLD_TIME_GPIO=1

CONFIG_COMPILER_OPTIMIZATION_SIZE=y
CONFIG_FATFS_LFN_HEAP=y
```
